OUTPUT_FORMAT("elf32-i386","elf32-i386","elf32-i386");
OUTPUT_ARCH("i386")
ENTRY(_start)

SECTIONS
{
    /* our kernel is loaded at 0x200000 */
    . = 0x200000;
    __b_load   = .;

    /* the multiboot header MUST come early enough in the output
       object file */
    .multiboot :
    {
        /* The multiboot section (containing the multiboot header)
           goes here */
	*(.multiboot);
	
	/*
	 * With the following line, we force this section to be
	 * allocated in the output file as soon as possible, no matter
	 * when the file containing the multiboot header (multiboot.S)
	 * is compiled. This is to conform to the multiboot spec, which
	 * says "The Multiboot header must be contained completely
	 * within the first 8192 bytes of the OS image, and must be
	 * longword (32-bit) aligned."
	 */
	LONG(0);
    }

    /* Defines a symbol '__b_kernel to mark the start of the kernel
       code/data */
    . = ALIGN(4096);
    __b_kernel = .;
  
    /* Beginning of the text section */
    .text ALIGN(4096) :
    {   
	/* This section includes the code */
        *(.text*)
	/* Defines the 'etext' and '_etext' at the end */
        PROVIDE(etext = .);
        PROVIDE(_etext = .);
    }

    /* Beginning of the data section */
    .data ALIGN(4096) :
    {
		*(.data*) 
        PROVIDE(edata = .);
		PROVIDE(_edata = .);
    }
    
    .debug ALIGN(4096) :
    {
    	*(.debug*)
    }

    /* We take note of the end of the data to load */
    __e_load = .;

    /* Beginning of the BSS section (global uninitialized data) */
    .bss ALIGN(4096) :
    {
		*(.bss)
        *(COMMON)
        PROVIDE(ebss = .);
		PROVIDE(_ebss = .);
    }

    /* We take note of the end of the kernel */
    __e_kernel = .;

    /* We don't care of the note, indent, comment, etc.. sections
       generated by gcc */
        /DISCARD/ :{
                *(.note*)
                *(.indent)
                *(.comment)
                *(.stab)
                *(.stabstr)
        }
}
